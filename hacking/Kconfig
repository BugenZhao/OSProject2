## hacking/Kconfig
```kconfig
# added the killer as a feature

#
# For a description of the syntax of this configuration file,
# see Documentation/kbuild/kconfig-language.txt.
#
mainmenu "Linux/$ARCH $KERNELVERSION Kernel Configuration"

config SRCARCH
	string
	option env="SRCARCH"

source "arch/$SRCARCH/Kconfig"

# bugen's oom killer feature
config BUGEN_OOM_KILLER
	bool "Bugen's OOM Killer Feature"
	default y
```
